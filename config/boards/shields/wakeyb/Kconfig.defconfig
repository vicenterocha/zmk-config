## config/boards/shields/wakeyb/Kconfig.defconfig
```kconfig
if SHIELD_WAKEYB_LEFT

config ZMK_KEYBOARD_NAME
	default "Wakeyb"

config ZMK_SPLIT_BLE_ROLE_CENTRAL
	default y

endif

if SHIELD_WAKEYB_LEFT || SHIELD_WAKEYB_RIGHT

config ZMK_SPLIT
	default y

endif
```

## config/boards/shields/wakeyb/Kconfig.shield
```kconfig
# Copyright (c) 2022 Vicente Rocha
# SPDX-License-Identifier: MIT

config SHIELD_WAKEYB_LEFT
	def_bool $(shields_list_contains,wakeyb_left)

config SHIELD_WAKEYB_RIGHT
	def_bool $(shields_list_contains,wakeyb_right)
```

## config/boards/shields/wakeyb_v2/Kconfig.shield
```kconfig
# Copyright (c) 2022 Vicente Rocha
# SPDX-License-Identifier: MIT

config SHIELD_WAKEYB_LEFT
	def_bool $(shields_list_contains,wakeyb_v2_left)

config SHIELD_WAKEYB_RIGHT
	def_bool $(shields_list_contains,wakeyb_v2_right)
```
