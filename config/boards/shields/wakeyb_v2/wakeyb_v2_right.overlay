/*
 * Copyright (c) 2020 Pete Johanson
 *
 * SPDX-License-Identifier: MIT
 */

#include "wakeyb_v2.dtsi"

&default_transform {
	col-offset = <6>;
};

&kscan0 {
    row-gpios
		= <&pro_micro 20 (GPIO_ACTIVE_HIGH | GPIO_PULL_DOWN)> // Row A from the schematic file
		, <&pro_micro 19 (GPIO_ACTIVE_HIGH | GPIO_PULL_DOWN)> // Row B from the schematic file
		, <&pro_micro 18 (GPIO_ACTIVE_HIGH | GPIO_PULL_DOWN)> // Row C from the schematic file
		, <&pro_micro 15 (GPIO_ACTIVE_HIGH | GPIO_PULL_DOWN)> // Row D from the schematic file
		, <&pro_micro 14 (GPIO_ACTIVE_HIGH | GPIO_PULL_DOWN)> // Row E from the schematic file
		;
	col-gpios
	    = <&pro_micro 7 GPIO_ACTIVE_HIGH>  // left most
        , <&pro_micro 6 GPIO_ACTIVE_HIGH>  // index finger
        , <&pro_micro 5 GPIO_ACTIVE_HIGH>  // middle finger
        , <&pro_micro 4 GPIO_ACTIVE_HIGH>  // ring finger
        , <&pro_micro 3 GPIO_ACTIVE_HIGH>  // pinky
        , <&pro_micro 2 GPIO_ACTIVE_HIGH>  // right most
        ;
};